## config/west.yml
```yaml
manifest:
  remotes:
    - name: zmkfirmware
      url-base: https://github.com/zmkfirmware
  projects:
    - name: zmk
      remote: zmkfirmware
      revision: main
      import: app/west.yml
    - name: zmk-cannonkeys-keyboards
      url: https://github.com/cannonkeys/zmk-cannonkeys-keyboards
      revision: main
      path: modules/zmk-cannonkeys-keyboards
  self:
    path: config
```
